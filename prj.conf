## CMakeLists.txt
```
cmake_minimum_required(VERSION 3.20.0)
find_package(Zephyr REQUIRED HINTS $ENV{ZEPHYR_BASE})
project(DEV_HUB_Nrf91_LTE)

# Add the Main source files
target_sources(app
    PRIVATE
    src/main.c
)

# Add the component LTE
target_sources(app PRIVATE
    components/lte/lte.c)
target_include_directories(app
    PRIVATE
    ${CMAKE_CURRENT_SOURCE_DIR}/components/lte
)
```

## prj.conf
```kconfig
# Logging
CONFIG_LOG=y

# Network
CONFIG_NETWORKING=y
CONFIG_NET_NATIVE=n
CONFIG_NET_SOCKETS=y
CONFIG_NET_SOCKETS_OFFLOAD=y

# Memory
CONFIG_HEAP_MEM_POOL_SIZE=4096
CONFIG_MAIN_STACK_SIZE=4096

# Modem library
CONFIG_NRF_MODEM_LIB=y
CONFIG_MODEM_INFO=y
CONFIG_NRF_MODEM_LIB_ON_FAULT_RESET_MODEM=y

# LTE link control
CONFIG_LTE_LINK_CONTROL=y
CONFIG_LTE_NETWORK_MODE_LTE_M=y
# CONFIG_LTE_LC_PSM_MODULE=y
# CONFIG_LTE_LC_EDRX_MODULE=y
# CONFIG_LTE_LC_MODEM_SLEEP_MODULE=y
# CONFIG_LTE_LC_TAU_PRE_WARNING_MODULE=y


# AT commands interface
CONFIG_AT_HOST_LIBRARY=y
CONFIG_UART_INTERRUPT_DRIVEN=y

# Enable floating point unit
CONFIG_NEWLIB_LIBC=y
CONFIG_NEWLIB_LIBC_FLOAT_PRINTF=y
```

## src/main.c
```c
#include <stdio.h>
#include <zephyr/kernel.h>
#include <zephyr/logging/log.h>
#include "lte.h"

LOG_MODULE_REGISTER(Main);

int main(void)
{
	int err;

	err = modem_init();
	if (err)
	{
		LOG_ERR("Failed to configure the modem");
		return 0;
	}

	err = lte_init();
	if (err)
	{
		LOG_ERR("Failed to intialize LTE");
	}

	LOG_INF("Connected to LTE network");

	return 0;
}
```
